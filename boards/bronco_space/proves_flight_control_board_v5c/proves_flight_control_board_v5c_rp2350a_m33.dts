/*
 * Copyright (c) 2024 Andrew Featherstone
 *
 * SPDX-License-Identifier: Apache-2.0
 */

/dts-v1/;

/* The build system assumes that there's a cpucluster-specific file.
 *
 * This file provides composition of the device tree:
 * 1. The common features of the SoC
 * 2. Core-specific configuration.
 * 3. Board-specific configuration.
 */
#include <raspberrypi/rpi_pico/rp2350a.dtsi>
#include <raspberrypi/rpi_pico/m33.dtsi>

#include "../proves_flight_control_board_v5/proves_flight_control_board_v5.dtsi"


&spi1 {
	status = "okay";
	cs-gpios = <&gpio0 9 GPIO_ACTIVE_LOW>;
	pinctrl-0 = <&spi1_default>;
	pinctrl-names = "default";

	lora0: sx1276@0 {
		compatible = "semtech,sx1276";
		reg = <0>;
		spi-max-frequency = <125000>;
		dio-gpios =  <&gpio0 13 (GPIO_PULL_DOWN | GPIO_ACTIVE_HIGH)>,<&gpio0 12 (GPIO_PULL_DOWN | GPIO_ACTIVE_HIGH)>;
		reset-gpios = <&gpio0 6 GPIO_ACTIVE_LOW>;
		power-amplifier-output = "pa-boost";
		label = "HOPE_RF";
	};
};
